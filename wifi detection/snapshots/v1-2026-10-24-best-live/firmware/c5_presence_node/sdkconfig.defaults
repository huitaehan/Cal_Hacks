## wifi detection/snapshots/v1-2026-10-24-best-live/firmware/c5_presence_node/sdkconfig.defaults
```kconfig
CONFIG_IDF_TARGET="esp32c5"
CONFIG_ESPTOOLPY_FLASHSIZE_4MB=y
CONFIG_PARTITION_TABLE_SINGLE_APP_LARGE=y
CONFIG_COMPILER_OPTIMIZATION_PERF=y

# Data and logs go out over the board's native USB port
CONFIG_ESP_CONSOLE_USB_SERIAL_JTAG=y

# CSI capture
CONFIG_ESP_WIFI_CSI_ENABLED=y

CONFIG_FREERTOS_HZ=1000
CONFIG_ESP_TASK_WDT_TIMEOUT_S=10
CONFIG_LOG_DEFAULT_LEVEL_INFO=y
```
